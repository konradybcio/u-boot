## board/qualcomm/rb1/rb1.its
```
/*
 * U-Boot uImage source file with multiple kernels, ramdisks and FDT blobs
 */

/dts-v1/;

/ {
	description = "Various kernels, ramdisks and FDT blobs";
	#address-cells = <1>;

	images {
		kernel-uefi {
			description = "Linux Kernel (EFI)";
			data = /incbin/("./rb1_imgs/grubaa64.efi");
			type = "kernel";
			arch = "arm64";
			os = "efi";
			compression = "none";
			load = <0x90008000>;
			entry = <0x90008000>;
			hash-1 {
				algo = "sha1";
			};
		};

		initrd {
			description = "Initial ramdisk";
			data = /incbin/("./rb1_imgs/initramfs-tiny-image-qemuarm64-20230209073803-1343.rootfs.cpio.gz");
			type = "ramdisk";
			arch = "arm64";
			os = "linux";
			compression = "gzip";
			load = <00000000>;
			entry = <00000000>;
			hash-1 {
				algo = "sha1";
			};
		};

		fdt-rb1v2 {
			description = "RB1 v2 FDT";
			data = /incbin/("./rb1_imgs/qrb2210-rb1.dtb");
			type = "flat_dt";
			arch = "arm64";
			compression = "none";
			load = <0x94000000>;
			hash-1 {
				algo = "sha1";
			};
		};

	};

	configurations {
		default = "config-1";

		config-1 {
			description = "RB1 v2";
			kernel = "kernel-uefi";
			ramdisk = "initrd";
			fdt = "fdt-rb1v2";
		};
	};
};
```
